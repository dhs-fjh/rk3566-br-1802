## configs/rockchip_rk3566_defconfig
```kconfig
#include "audio.config"
#include "audio_gst.config"
#include "base.config"
#include "base_extra.config"
#include "benchmark.config"
#include "camera.config"
#include "camera_gst.config"
#include "debug.config"
#include "debug2.config"
#include "weston.config"
#include "gpu.config"
#include "network.config"
#include "ntfs.config"
#include "video_mpp.config"
#include "video_gst.config"
#include "video_gst_rtsp.config"
#include "powermanager.config"
#include "rk356x_arm64.config"
#include "test.config"

BR2_KERNEL_HEADERS_4_19=y
BR2_TOOLCHAIN_HEADERS_AT_LEAST_4_19=y
BR2_TOOLCHAIN_HEADERS_AT_LEAST="4.19"

BR2_DEFAULT_KERNEL_HEADERS="4.19.194"
BR2_PACKAGE_LINUX_HEADERS=y
BR2_PACKAGE_LINUX_HEADERS_AUTO_VERSION=y

BR2_PACKAGE_FFMPEG=y
BR2_PACKAGE_FFMPEG_FFPROBE=y
BR2_PACKAGE_FFMPEG_FFPLAY=y
BR2_PACKAGE_FFMPEG_GPL=y
BR2_PACKAGE_FFMPEG_NONFREE=y

BR2_PACKAGE_GST1_PLUGINS_GOOD=y
BR2_PACKAGE_GST1_PLUGINS_BAD_PLUGIN_X265=y
BR2_PACKAGE_GST1_PLUGINS_UGLY_PLUGIN_X264=y
BR2_PACKAGE_GST1_PLUGINS_GOOD_PLUGIN_WAVENC=y
BR2_PACKAGE_GST1_PLUGINS_GOOD_PLUGIN_WAVPACK=y

BR2_PACKAGE_GST1_PYTHON=y
BR2_PACKAGE_LIBGPIOD=y
BR2_PACKAGE_LIBGPIOD_TOOLS=y

BR2_PACKAGE_PYTHON3=y


BR2_PACKAGE_PULSEAUDIO_HAS_ATOMIC=y
BR2_PACKAGE_PULSEAUDIO_ENABLE_ATOMIC=y
BR2_PACKAGE_PULSEAUDIO=y
BR2_PACKAGE_PULSEAUDIO_DAEMON=y
BR2_PACKAGE_SOX=y

BR2_PACKAGE_TREE=y
```
